## boards/tankalert/tankalert_esp32/Kconfig.defconfig
```kconfig
# SPDX-License-Identifier: Apache-2.0

config BOARD_TANKALERT_ESP32
	select SOC_ESP32_PROCPU
```

## boards/tankalert/tankalert_esp32/Kconfig.tankalert_esp32
```kconfig
# SPDX-License-Identifier: Apache-2.0

config BOARD_TANKALERT_ESP32
	bool "TankAlert ESP32-WROOM custom board"
	select SOC_ESP32
```

## boards/tankalert/tankalert_esp32/board.yml
```yaml
board:
  name: tankalert_esp32
  full_name: TankAlert ESP32-WROOM
  vendor: tankalert
  socs:
    - name: esp32
```
